## config/boards/shields/scylla/Kconfig.defconfig
```kconfig
# Copyright (c) 2022 The ZMK Contributors
# SPDX-License-Identifier: MIT

if SHIELD_SCYLLA_RIGHT_TRACKPOINT

config ZMK_KEYBOARD_NAME
    default "Scylla"

config ZMK_SPLIT_ROLE_CENTRAL
    default y

endif

if SHIELD_SCYLLA_LEFT || SHIELD_SCYLLA_RIGHT_TRACKPOINT

config ZMK_SPLIT
    default y

endif
```

## config/boards/shields/scylla/Kconfig.shield
```kconfig
# Copyright (c) 2022 The ZMK Contributors
# SPDX-License-Identifier: MIT

config SHIELD_SCYLLA_LEFT
    def_bool $(shields_list_contains,scylla_left)

config SHIELD_SCYLLA_RIGHT_TRACKPOINT
    def_bool $(shields_list_contains,scylla_right_trackpoint)
```
